## LTE01R02A05_C_SDK_G/components/fs/Kconfig
```kconfig
# Copyright (C) 2018 RDA Technologies Limited and/or its affiliates("RDA").
# All rights reserved.
#
# This software is supplied "AS IS" without any warranties.
# RDA assumes no responsibility or liability for the use of the software,
# conveys no license or title under any patent, copyright, or mask work
# right to the product. RDA reserves the right to make changes in the
# software without notification.  RDA also make no representation or
# warranty that such application will be suitable for the specified use
# without further testing or modification.

menu "file system"

choice
    prompt "flash block device version"
    default FS_FBDEV_DEFAULT_V2
    help
        There are 2 versions of flash block device implementation. These
        2 versions are incompatible.

    config FS_FBDEV_DEFAULT_V1
        bool "version 1"

    config FS_FBDEV_DEFAULT_V2
        bool "version 2"
endchoice

config FS_FBDEV_V1_SUPPORTED
    bool "Support flash block device v1"
    default n
    help
        When enabled, flash block device v1 will be supported. Except for
        backward compatible consideration, don't enable it.

config FS_FBDEV_V2_SUPPORTED
    bool "Support flash block device v2"
    default y
    help
        When enabled, flash block device v2 will be supported.

config FS_FORMAT_FLASH_ON_MOUNT_FAIL
    bool "format at mount fail"
    default n
    help
        When file system mount failed, system can't go on. When this is
        enabled, system will format the flash region, and try mount again.
        Then system can go on, but all existed data will be lost.

        Don't enable this in production.

config FS_MOUNT_SDCARD
    bool "Mount sdcard"
    depends on SDIO_SUPPORT
    default n
    help
        When EMMC and SDMMC Driver support,can be mounted.

if FS_MOUNT_SDCARD

config FS_FORMAT_SDCARD_ON_MOUNT_FAIL
    bool "Format sdcard on mount fail"
    default y


choice
    prompt "Select File System on the SDCard"
    default FS_SUPPORT_FAT_ON_SDCARD

    config FS_SUPPORT_LFS_ON_SDCARD
        bool "Support LittleFS on EMMC or SDCard"
        help
            When this is enabled, user can mount LittleFS on a EMMC or SDCard,
            then reads and writes the file system by vfs APIs.

    config FS_SUPPORT_FAT_ON_SDCARD
        bool "Support Fat on EMMC or SDCard"
        help
            When this is enabled, user can mount Fat file system on a EMMC or SDCard,
            then reads and writes the file system by vfs APIs.
endchoice

endif

config FS_SDCARD_MOUNT_POINT
    string "Sdcard mount point"
    default "/sdcard0"

config FS_EMMC_MOUNT_POINT
    string "eMMC mount point"
    default "/emmc/part0"

config FS_NFTL_MOUNT_POINT
    string "nftl-based raw nand chip mount point"
    default "/nftl/part0"

config FS_SDCARD_PART_NUM
    int "The Number of Partitions divided on SDCard"
    #default 1
    default 4 #adjust by quectel
    
if FS_SDCARD_PART_NUM = 2
config SDCARD_PART_NUM0
    int "sdcard_part_num0"
    default 0
    help
        sdcard_part_num0 percentage occupancy.

config SDCARD_PART_NUM1
    int "sdcard_part_num1"
    default 0
    help
        sdcard_part_num1 percentage occupancy.
endif

if FS_SDCARD_PART_NUM = 3
config SDCARD_PART_NUM0
    int "sdcard_part_num0"
    default 0
    help
        sdcard_part_num0 percentage occupancy.

config SDCARD_PART_NUM1
    int "sdcard_part_num1"
    default 0
    help
        sdcard_part_num1 percentage occupancy.

config SDCARD_PART_NUM2
    int "sdcard_part_num2"
    default 0
    help
        sdcard_part_num2 percentage occupancy.
endif

if FS_SDCARD_PART_NUM = 4
config SDCARD_PART_NUM0
    int "sdcard_part_num0"
    default 0
    help
        sdcard_part_num0 percentage occupancy.

config SDCARD_PART_NUM1
    int "sdcard_part_num1"
    default 0
    help
        sdcard_part_num1 percentage occupancy.

config SDCARD_PART_NUM2
    int "sdcard_part_num2"
    default 0
    help
        sdcard_part_num2 percentage occupancy.

config SDCARD_PART_NUM3
    int "sdcard_part_num3"
    default 0
    help
        sdcard_part_num3 percentage occupancy.
endif

config FS_SUPPORT_NAND_SFS
    bool "SUPPORT NAND SFS"
    default n
    help
        When NAND Driver support,can be used.

config FS_SUPPORT_LFS_ON_NAND
    bool "Support LittleFS on NAND flash"
    default n
    help
        When this is enabled, user can mount a LittleFS on a raw nand flash,
        then reads and writes the file system by vfs APIs.

config FS_NFTL_PART_NUM
    int "The Number of Partitions divided on Raw Nand Flash"
    default 1

endmenu
```
